## CMakeLists.txt
```
#
# wolfssl/CMakeLists.txt
#
# Copyright (C) 2024-2025 Javier Blanco-Romero @fj-blanco (UC3M, QURSA project)
#
# CMake configuration for CoAP client with wolfSSL
#

cmake_minimum_required(VERSION 3.20.0)

find_package(Zephyr REQUIRED HINTS $ENV{ZEPHYR_BASE})
project(libcoap_wolfssl_client)

# CoAP server configuration
set(COAP_SERVER_IP_VALUE $ENV{COAP_IP})
set(COAP_SERVER_PATH_VALUE $ENV{COAP_PATH})
set(COAP_SERVER_PORT_VALUE $ENV{COAP_PORT})

if(DEFINED COAP_IP)
    set(COAP_SERVER_IP_VALUE ${COAP_IP})
endif()

if(DEFINED COAP_PATH)
    set(COAP_SERVER_PATH_VALUE ${COAP_PATH})
endif()

if(DEFINED COAP_PORT)
    set(COAP_SERVER_PORT_VALUE ${COAP_PORT})
endif()

if(NOT COAP_SERVER_IP_VALUE)
    set(COAP_SERVER_IP_VALUE "134.102.218.18")
endif()

if(NOT COAP_SERVER_PATH_VALUE)
    set(COAP_SERVER_PATH_VALUE "/hello")
endif()

if(NOT COAP_SERVER_PORT_VALUE)
    set(COAP_SERVER_PORT_VALUE "5683")
endif()

# DTLS configuration
set(USE_DTLS_VALUE $ENV{USE_DTLS})
if(DEFINED USE_DTLS)
    set(USE_DTLS_VALUE ${USE_DTLS})
endif()

# COAP_WOLFSSL_GROUPS — colon-separated TLS 1.3 named groups for libcoap.
# Same mechanism used on the server side (install_libcoap.sh).
# Examples: "P-256", "X25519", "ML_KEM_512", "P-256:ML_KEM_768"
# On ESP32 only ONE ML-KEM level fits in DRAM; specify a single group per build.
set(COAP_WOLFSSL_GROUPS_VALUE $ENV{COAP_WOLFSSL_GROUPS})
if(DEFINED COAP_WOLFSSL_GROUPS)
    set(COAP_WOLFSSL_GROUPS_VALUE ${COAP_WOLFSSL_GROUPS})
endif()

# COAP_WOLFSSL_SIG — signature algorithm for certificate authentication.
# Examples: "ECDSA_P256" (default), "ML_DSA_44"
set(COAP_WOLFSSL_SIG_VALUE $ENV{COAP_WOLFSSL_SIG})
if(DEFINED COAP_WOLFSSL_SIG)
    set(COAP_WOLFSSL_SIG_VALUE ${COAP_WOLFSSL_SIG})
endif()

# Handle WiFi configuration
set(WIFI_SSID_VALUE $ENV{WIFI_SSID})
set(WIFI_PASS_VALUE $ENV{WIFI_PASS})

if(DEFINED WIFI_SSID)
    set(WIFI_SSID_VALUE ${WIFI_SSID})
endif()

if(DEFINED WIFI_PASS)
    set(WIFI_PASS_VALUE ${WIFI_PASS})
endif()

if(NOT WIFI_SSID_VALUE)
    set(WIFI_SSID_VALUE "WIFI_SSID_NOT_SET")
endif()

if(NOT WIFI_PASS_VALUE)
    set(WIFI_PASS_VALUE "WIFI_PASS_NOT_SET")
endif()

zephyr_include_directories(include)

target_include_directories(app PRIVATE ${CMAKE_CURRENT_SOURCE_DIR}/include)
target_sources(app PRIVATE src/main.c src/wifi.c)
target_link_libraries(app PRIVATE coap-3)

target_compile_definitions(app PRIVATE
    COAP_SERVER_IP="${COAP_SERVER_IP_VALUE}"
    COAP_SERVER_PATH="${COAP_SERVER_PATH_VALUE}"
    COAP_SERVER_PORT=${COAP_SERVER_PORT_VALUE}
    WIFI_SSID="${WIFI_SSID_VALUE}"
    WIFI_PASS="${WIFI_PASS_VALUE}"
)

# Add DTLS support if enabled
if(USE_DTLS_VALUE)
    target_compile_definitions(app PRIVATE USE_DTLS=1)
    message(STATUS "DTLS mode: ENABLED")
else()
    message(STATUS "DTLS mode: DISABLED")
endif()

# ── COAP_WOLFSSL_GROUPS → libcoap + wolfSSL config ──────────────
# Pass the groups string to libcoap so coap_wolfssl.c calls
# wolfSSL_CTX_set1_groups_list() with these groups at runtime.
# Also derive the WOLFSSL_ALGO_* define that the parametric
# config-wolfssl-libcoap.h uses to enable only the needed crypto
# (critical for ESP32 DRAM budget).
if(COAP_WOLFSSL_GROUPS_VALUE)
    target_compile_definitions(coap-3 PRIVATE
        COAP_WOLFSSL_GROUPS="${COAP_WOLFSSL_GROUPS_VALUE}")
endif()

# ── Pre-define cipher lists to eliminate 3×4096-byte static buffers ──
# coap_wolfssl.c allocates psk_ciphers[4096], pki_ciphers[4096], and
# ciphers[4096] when these macros are NOT defined.  Pre-defining them
# turns each into a tiny initialized string → saves ~12 KB DRAM.
# For TLS 1.3 (DTLS 1.3) we only use AES-128-GCM-SHA256.
target_compile_definitions(coap-3 PRIVATE
    COAP_WOLFSSL_PKI_CIPHERS="TLS13-AES128-GCM-SHA256"
    COAP_WOLFSSL_PSK_CIPHERS="TLS13-AES128-GCM-SHA256"
)

if(COAP_WOLFSSL_GROUPS_VALUE)

    # Map groups string → wolfSSL config header switch.
    # Only the first ML-KEM level found wins (ESP32 fits one at a time).
    if(COAP_WOLFSSL_GROUPS_VALUE MATCHES "ML_KEM_1024")
        set(_WOLFSSL_ALGO "MLKEM1024")
    elseif(COAP_WOLFSSL_GROUPS_VALUE MATCHES "ML_KEM_768")
        set(_WOLFSSL_ALGO "MLKEM768")
    elseif(COAP_WOLFSSL_GROUPS_VALUE MATCHES "ML_KEM_512")
        set(_WOLFSSL_ALGO "MLKEM512")
    elseif(COAP_WOLFSSL_GROUPS_VALUE MATCHES "X25519")
        set(_WOLFSSL_ALGO "X25519")
    else()
        set(_WOLFSSL_ALGO "ECDHE_P256")
    endif()
else()
    set(_WOLFSSL_ALGO "ECDHE_P256")
endif()

# Use zephyr_compile_definitions so the algo define is visible to ALL targets
# (app, wolfSSL module, libcoap).  This is critical for non-P-256 algorithms
# because config-wolfssl-libcoap.h gates crypto enablement via these defines,
# and the header is compiled as part of the wolfSSL Zephyr module.
zephyr_compile_definitions(WOLFSSL_ALGO_${_WOLFSSL_ALGO}=1)

# ── COAP_WOLFSSL_SIG → signature algorithm selection ──────────────
# Maps the signature algorithm string to WOLFSSL_SIG_* defines.
if(COAP_WOLFSSL_SIG_VALUE MATCHES "ML_DSA_44")
    set(_WOLFSSL_SIG "MLDSA44")
else()
    set(_WOLFSSL_SIG "ECDSA_P256")
endif()

zephyr_compile_definitions(WOLFSSL_SIG_${_WOLFSSL_SIG}=1)

# Raise DTLS MTU from the libcoap default of 1152 to ~Ethernet/WiFi max.
# Fewer DTLS fragments = fewer lost packets = faster PQ handshakes.
zephyr_compile_definitions(COAP_DEFAULT_MTU=1400)

# Halve the DTLS retransmission base timer (default 1000 ms) so the first
# retry fires sooner after a lost fragment.  Combined with a higher
# max_retransmit (set at runtime), this gives PQ handshakes many more
# chances within the 30 s application timeout.
zephyr_compile_definitions(COAP_DTLS_RETRANSMIT_MS=500)

# ── SKIP_PEER_VERIFY → disable DTLS certificate verification ─────
# When set, the client accepts any server certificate without checking
# the CA chain.  Useful for lab/benchmarking with self-signed certs.
if(DEFINED ENV{SKIP_PEER_VERIFY})
    target_compile_definitions(app PRIVATE SKIP_PEER_VERIFY=1)
    set(_VERIFY_PEER "OFF")
else()
    set(_VERIFY_PEER "ON")
endif()

message(STATUS "...............................................")
message(STATUS "ZEPHYR_EXTRA_MODULES after Zephyr package: ${ZEPHYR_EXTRA_MODULES}")
message(STATUS "wolfSSL configuration enabled")
message(STATUS "COAP_WOLFSSL_GROUPS: ${COAP_WOLFSSL_GROUPS_VALUE}")
message(STATUS "wolfSSL key exchange: ${_WOLFSSL_ALGO}")
message(STATUS "wolfSSL signature:    ${_WOLFSSL_SIG}")
message(STATUS "Verify peer cert:     ${_VERIFY_PEER}")
message(STATUS "CoAP Server: ${COAP_SERVER_IP_VALUE}${COAP_SERVER_PATH_VALUE}:${COAP_SERVER_PORT_VALUE}")
message(STATUS "WiFi Network: ${WIFI_SSID_VALUE}")
message(STATUS "...............................................")
```

## west.yml
```
manifest:
  defaults:
    remote: zephyrproject
  
  remotes:
    - name: fjblanco
      url-base: https://github.com/fj-blanco
    - name: zephyrproject
      url-base: https://github.com/zephyrproject-rtos
    - name: libcoap-custom
      url-base: https://github.com/fj-blanco/libcoap
    - name: wolfssl
      url-base: https://github.com/wolfssl
  
  projects:
    # Zephyr v4.1.0 fork with BLAKE2s entropy pool driver
    - name: zephyr
      remote: fjblanco
      repo-path: zephyr
      revision: 028d1947465c192509694cc1b8b5ef6bc7e1bad1
      path: zephyr
      import: true
    - name: libcoap
      url: https://github.com/fj-blanco/libcoap.git
      revision: 5b4767d6b1542efcbd98ae689dac9e50549ed490  # zephyr_wolfssl_esp32_opt
      path: modules/lib/libcoap
    - name: wolfssl
      remote: wolfssl
      repo-path: wolfssl
      revision: v5.8.2-stable
      path: modules/crypto/wolfssl
  
  self:
    path: .
```

## prj.conf
```kconfig
# ESP32 libcoap wolfSSL Configuration

# Core System
CONFIG_NEWLIB_LIBC=y
CONFIG_POSIX_API=y
CONFIG_XOPEN_STREAMS=y

# Memory — tuned for PQC (ML-KEM-512 / ML-DSA-44) + DTLS 1.3 within ESP32 DRAM.
# wolfSSL_new() needs ~30-40 KB for DTLS 1.3; wolfSSL_connect() needs additional
# buffers for handshake construction, key gen, output record.
# ML-DSA-44 certificates (~5.6 KB each) require DTLS fragment reassembly buffers
# of ~12 KB, so 98304 (96 KB) provides sufficient headroom.
# NOTE: ML-DSA-44 dilithium_verify_mu needs an 8104-byte XMALLOC during cert
# verification, and then AllocKey needs ~4200 bytes for peer dilithium_key.
# ML-DSA-44 handshake peaks at ~95 KB sys_heap; we need enough headroom so that
# allocations during + after ConfirmSignature (cert verify callback, key decode,
# etc.) don't fail.  Transfer 8 KB from stacks → sys_heap:
#   main stack: 20480 → 12288 (measured peak call depth 22 frames; with
#               WOLFSSL_SMALL_STACK, large arrays go to heap; 12 KB is ample)
#   workqueue: 2048 → 1024   idle: 2048 → 1024
# NOTE: ML-KEM-768/1024 certificates may still exceed ESP32 heap headroom.
# ML-KEM-512 + cert-verify peaks at 70,436 bytes allocated; with 104,448 pool
# fragmentation after ~14 iterations causes OOM.  Add 3 KB from DRAM headroom.
CONFIG_MAIN_STACK_SIZE=12288
CONFIG_SYSTEM_WORKQUEUE_STACK_SIZE=1024
CONFIG_IDLE_STACK_SIZE=1024
CONFIG_HEAP_MEM_POOL_SIZE=107520

# Debugging
CONFIG_LOG=y
CONFIG_LOG_DEFAULT_LEVEL=2
CONFIG_PRINTK=y
CONFIG_EARLY_CONSOLE=y
CONFIG_ASSERT=n

# Heap runtime statistics — tracks allocated, free, and peak usage
CONFIG_SYS_HEAP_RUNTIME_STATS=y

# Hardware
CONFIG_SERIAL=y
CONFIG_UART_CONSOLE=y
CONFIG_CONSOLE=y
CONFIG_GPIO=y

# Networking
CONFIG_NETWORKING=y
CONFIG_NET_SOCKETS=y

# Network Stack
CONFIG_NET_IPV4=y
CONFIG_NET_IPV6=n
CONFIG_NET_UDP=y
CONFIG_NET_TCP=n
CONFIG_NET_DHCPV4=y

# Network Management
CONFIG_NET_L2_ETHERNET=y
CONFIG_NET_L2_ETHERNET_MGMT=y
CONFIG_NET_MGMT=y
CONFIG_NET_MGMT_EVENT=y

# WiFi Configuration
CONFIG_WIFI=y
CONFIG_NET_L2_WIFI_MGMT=y

# -------- MbedTLS (required by ESP32 WiFi driver, NOT the app TLS backend) --------
CONFIG_MBEDTLS=y
CONFIG_MBEDTLS_BUILTIN=y
CONFIG_MBEDTLS_ENABLE_HEAP=y
CONFIG_MBEDTLS_HEAP_SIZE=4096
CONFIG_MBEDTLS_USER_CONFIG_ENABLE=y
CONFIG_MBEDTLS_USER_CONFIG_FILE="config-mbedtls-wifi.h"

# Disable TLS/DTLS protocol — WiFi uses only raw crypto primitives
CONFIG_MBEDTLS_TLS_VERSION_1_2=n
CONFIG_MBEDTLS_DTLS=n

# Disable all key exchanges — WiFi WPA2-Personal doesn't use TLS handshakes
CONFIG_MBEDTLS_KEY_EXCHANGE_ALL_ENABLED=n
CONFIG_MBEDTLS_KEY_EXCHANGE_PSK_ENABLED=n
CONFIG_MBEDTLS_KEY_EXCHANGE_DHE_PSK_ENABLED=n
CONFIG_MBEDTLS_KEY_EXCHANGE_RSA_PSK_ENABLED=n
CONFIG_MBEDTLS_KEY_EXCHANGE_RSA_ENABLED=n
CONFIG_MBEDTLS_KEY_EXCHANGE_DHE_RSA_ENABLED=n
CONFIG_MBEDTLS_KEY_EXCHANGE_ECJPAKE_ENABLED=n

# Disable extras not needed for WiFi
CONFIG_MBEDTLS_PEM_CERTIFICATE_FORMAT=n
CONFIG_MBEDTLS_SERVER_NAME_INDICATION=n
CONFIG_MBEDTLS_SSL_EXTENDED_MASTER_SECRET=n
CONFIG_MBEDTLS_SSL_DTLS_CONNECTION_ID=n
CONFIG_MBEDTLS_GENPRIME_ENABLED=n
CONFIG_MBEDTLS_DEBUG=n

# ECC prerequisites (force-selected by WiFi driver, need curve + ASN1)
CONFIG_MBEDTLS_ECP_DP_SECP256R1_ENABLED=y

# -------- wolfSSL (application TLS/DTLS backend for libcoap) --------
CONFIG_ENTROPY_GENERATOR=y
CONFIG_ENTROPY_BLAKE2S=y
CONFIG_WOLFSSL=y
CONFIG_WOLFSSL_SETTINGS_FILE="config-wolfssl-libcoap.h"

# libcoap
CONFIG_LIBCOAP=y
CONFIG_LIBCOAP_CLIENT_SUPPORT=y

# Disable memory-intensive features
CONFIG_SHELL=n
CONFIG_PM=n
CONFIG_SMP=n
```

## boards/esp32_devkitc_procpu.overlay
```dts
/*
 * Copyright (c) 2022 Espressif Systems (Shanghai) Co., Ltd.
 * Copyright (C) 2024-2025 Javier Blanco-Romero @fj-blanco (UC3M, QURSA project)
 *
 * SPDX-License-Identifier: Apache-2.0
 */

&wifi {
	status = "okay";
};

/ {
	chosen {
		/* Use BLAKE2s pool as main entropy source */
		zephyr,entropy = &entropy_blake2s;
	};

	/* BLAKE2s entropy pool wrapping ESP32 hardware TRNG */
	entropy_blake2s: entropy-blake2s-pool {
		compatible = "zephyr,entropy-blake2s-pool";
		hardware-device = <&trng0>;  /* ESP32 hardware TRNG backend */
		status = "okay";
	};
};
```

## include/ca_certs.h
```c
/* Auto-generated by scripts/generate_ca_header.sh — do not edit manually.
 * Reads CA certs from qeaas-server/coap2http-proxy/certs/.
 *   ecc/ca-ecc-cert.pem              → ECDSA P-256 CA
 *   mldsa44/mldsa44_root_cert.pem    → ML-DSA-44 CA
 */
#ifndef CA_CERTS_H
#define CA_CERTS_H

/* ML-DSA-44 Root CA */
static const char ca_cert_mldsa44_pem[] =
    "-----BEGIN CERTIFICATE-----\n"
    "MIIP/jCCBnSgAwIBAgIQcxB1LxrxKOXPDsGA8bmX8TALBglghkgBZQMEAxEwcDEL\n"
    "MAkGA1UEBhMCRVMxDzANBgNVBAgMBk1hZHJpZDEQMA4GA1UEBwwHTGVnYW5lczEN\n"
    "MAsGA1UECgwEVUMzTTENMAsGA1UECwwER0FTVDEgMB4GA1UEAwwXUUVhYVMgTUwt\n"
    "RFNBLTQ0IFJvb3QgQ0EwIhgPMjAyNjAzMDUxOTQ4MTVaGA8yMDM2MDMwMzE5NDgx\n"
    "NVowcDELMAkGA1UEBhMCRVMxDzANBgNVBAgMBk1hZHJpZDEQMA4GA1UEBwwHTGVn\n"
    "YW5lczENMAsGA1UECgwEVUMzTTENMAsGA1UECwwER0FTVDEgMB4GA1UEAwwXUUVh\n"
    "YVMgTUwtRFNBLTQ0IFJvb3QgQ0EwggUyMAsGCWCGSAFlAwQDEQOCBSEABGFyYKTb\n"
    "Ie4IZzOt/XlV/MmjBzuKZlshGOSIDkeu8aCVlqf6Khkvb56nA+3fPlQ3+9GbqECp\n"
    "rb/7IBZcIpQrG0py6MJ2teotTRTED/9rCd7n+W8db3sdKGrRCZxqffhIW7x5PJcN\n"
    "7yqIbjNrIR0cQS2rzzEjFrl1v53SyXV2RvP2I6A5fnV/R8Vwa7OvDjLj8VT5D2In\n"
    "9t2wotxCI98BqjWEnyX9zglVTMNv5anFVB43EoH7emHAqt4Z5zVrq+WJURfN+vSh\n"
    "fwWmv3tnLPye6IQzL+ybrBf46V/bfhVlyXcLqF4iv+IJG8n8yD1OKocGoAba00X7\n"
    "L9L4FTeKxVtissnFXs3ngRB1NznLEnYH40elhy/DdSLwfwQkw7f5tzeBsw6Y9bun\n"
    "pKjR38KYnmgAHpACAnXzaU9o6TxX/Pv9urxrKWqX3gWS6jJvTqFGCc5HY2kLasm7\n"
    "Uq4AxTJ2piSyuhbEDi1gxX24UNQD5FOtboO8fhPV0lJhpEUi+m8n0lLQlPte4TBR\n"
    "CvNKz/dHpIcAqOkWpyjFG+Lu70jsKi1BxzvGBBFbAPog6D99yyzMRTkYz4mDmRcR\n"
    "Y0r9NVBlnoL+EqK7PcvBM2gXDecrVDl43X81WZCGgZ8Eb0ijykaGrvzaVckTlE1j\n"
    "NsMMgMmZjcz9PqwtRVtf8LfuIR+OZEAErSX5Z2fQB2/lxx/nIqpo+tgkXhwYCaz5\n"
    "tdHG8T7n8+/V/H9N48mF0uJotaxNVC1/dnzo7pV4gwf09BGozbZkY7FXgi8CWPwP\n"
    "vwpfL5Ci4UzkpotuR/OG4EdctJvAbsNR9zc8BwTjIqpNJ1G5tRdCOIKcsoQoX8rd\n"
    "ViuC2FiyH/U9DA5SWLDnBFJXn2lNXK4NdUMHpCau4bgBLTgsx1YZNMk3K6w9hMwr\n"
    "oIQ7MhCCG0hghUVl6axiVvVB1TH4ado89Qo++TXjpCMnzLkfx0Di2isb+kPoEv37\n"
    "cVcn7rVQL7fD+gmgtrYplu3pPUdLeK315d16QED48swW1buygmWRZN+Pt0KDYQca\n"
    "rtIMPdkGBy88eN1gRHnLwIEBb/YfzpAkvXWm1j56nO2h5LjsAriLE6YRu2b03C0F\n"
    "isJMt6uCzdeKozAi/kjrTTvMwi9/GI5jd7gHsky0a+gaDwvfbQ1TlViYeSxcgE6x\n"
    "IRhh5Y8LK/FZpyzepeMAR92ZwmNRw3JeUPTRVXD1d9zZlb1ZXUuJNPQ4wr/oSLAc\n"
    "rD7nMFbe4TzKXYA7NvuHeMNtfZ5+ELGePG+MBc0y1S9mvmIgFgnjwenW+0YmBctu\n"
    "d47M0NjIKzigGqo9pNO2DHgywdbGv10G4KpfVUpmY1uOz6ROupyzaiZtVbCnhxTb\n"
    "O0kL/zq6g/BbAdFrJJa/Mkzlx7l+wOG58J3qw5rJJrodcKctDOE2sgtlgYOe2TQu\n"
    "O1F1viw01gUo3+a1HmSBzGKG0nhuA29Y9ATuaB2d7dDqRP8vTn7XqY5WTh3VPnxF\n"
    "OhGBOM3xcewc/QPUNHrYm8izTaejuuvMGL/a5a9f2nc92n4RpgQzcV6g9rEvgjav\n"
    "7yHntqzuexVITS9i1fV6CK71tISYOiX5EmtNO1FPt4eVQJc4X9bEiUNh/sBNVb6y\n"
    "ZyCQR9y3Ts2jW1yxGAbCG3HSJ4IlUjokCtsiOsP+5w2tpP6m+3uEIKH4Z2QakAXc\n"
    "6ou1dJVsRXCrED5iThUnwb54LrVUTj63J0han6LOpObwvebQCHUvWsEfIJ15BKeh\n"
    "sEckJ/9jTAmsg6MQMA4wDAYDVR0TBAUwAwEB/zALBglghkgBZQMEAxEDggl1APPi\n"
    "lqFs2y6RC1lGLsgB6fFdiLhT2wZUgYvSFrMgWDpJNInN0PBEEc14s3/BlUZL0u4G\n"
    "Cewm92cQ9LfbJPcF9XDo/fEZpxhbS+ybNLuV/vGY7uqLZaMkxkTbylTcibbfMdyf\n"
    "n015hZdbzTtLzLyFRZP4EzmdP3NC3wDk1GhLx6frDJGmaJaPkGj9LdZzcc3GJcQK\n"
    "wcoybe1NEAF9U0ayCmLN4cHyaudk0yLz33TnUilNpV+y2zRlx8dUYoUpSXHLVNrj\n"
    "f9c9Mum9nrzg3WqucyqazRfAsBGUB8M0k3c619U6P7jPvVmKrY2fKCtHMyUUjrTA\n"
    "1VGvGRiu2JCsa2pdaxjWB+zMSsYtT0g+KhKGyeakFehRdc29g9UkYe5Zo3ei79Os\n"
    "Pykmz6yWhGhneLy033Vq1Xbc/Ks5qyi31KTcw7lGeAZQE7AE6tOTzql2nqLGBVXR\n"
    "s5pBBbmsqw4DOfMaq4zum1HUAHMS124gy762GWpIYEIzQApg3r+QCvQZUuDUFpZb\n"
    "JKzaiOmhKIFa/S5edtS1rHOw0lPQ6a10w1lUstzmMON0/holJ50pQSE0/1Nw2zMN\n"
    "7PViHq294F/hoPRWjzjdbSZv36bIxLHtqtc69HUypYj+nMyFol+pQpgg5P/E+2kD\n"
    "6jZb6qt2NW7E1wUxGG+ps3RrNHgfEk+Jjai0a36LLioyrvKC226G3LHVND0N5txU\n"
    "JjlzPxlEC0JVpwr8MGsrnyUmOdPbxjVHry3blHV5LTZvTFjigm7D+ItpRPvqzQqZ\n"
    "ptkP6MJlWKksz8pyVI2B/DGem/Tzv0hlGYftviEX5mv3sgsqTyLwFNvQtMSRzrzf\n"
    "5xClcg6P8Xv2PA6AYpBHsEbAGgOQ6w2piJaP7nHAd3IByDRhAtcoh6I9yxvKLlVG\n"
    "9qpR3BNdi4tM9uFRL6PPHWmazN+D2LaRI9mAVBCJ9TECODSNhsLIx4ufcC88Dnh8\n"
    "wKEnQxMUe7l9SgrXRtHN+Xg9exNy5WG+G1l4XEcktuMCX2QR1XONgHT2Ew/V2RD6\n"
    "HW7jvsSYxpTYQkMfkjMsE5/lRNGZ7PLgd8hMSizV4KlHrI5gyrXmhI4WQhucAFxy\n"
    "NyE4TqIQKK6UuQLOp3LaI1q2mXWO0O4HPQrUSsGRErr7jnAC+P9ZRU7mwUFeby/V\n"
    "tSyDnMnYWks6IopRO6ATm8XYL5ryGY47VH7FRYiMh098utglgCe4TEk6iMJKwaSi\n"
    "1/rMQzp2JQBz2iXDhN7yzqV8y+8czeWN95xr52toM63OzeovhjMvhzpXfrzTRrdy\n"
    "vR+Y/1EoqmmLqQsoVkr8J1ZE2Okxz21HTPHc4xwKAfG3i1cCL1Gk9Xi5/4fVYluJ\n"
    "LJt42JDGMBCXCFaWuPv8xcMHY1X67VJDa3qcqhFLVlqGneXqpmSSpUaOpq6JhXJQ\n"
    "FSExb5vqmHhXCwpC6iP/7TPGSuFgpgV5+htYlhVlzlI92B0EVQdXKBgEOxUqBjBp\n"
    "zDiOURXxxrcaKiMLIOzX+Bw5pjsL+XIfJpcJopWG7lYh0FKOFTtvzc/vFkHeNQml\n"
    "Kgf5cYbvNhZHOrTrtzEnX49KpVEvNeJw2KABoseWPUBiOCH+MrnhC6Vo5iErU9vq\n"
    "CIkT/oB5sFyEzQCnpX8pMYOQeCWPrM7yMLSaU4ZjsLwuWPTLAjQch3KipN5w+/7H\n"
    "vLSEGCNUsDLFNv8Ln3PA5rsBbZ/FUvJB5uwyq2zV3ItoZpAD5/FCIti78CvnCjRv\n"
    "i39ttFOF1/z5l6krJ7g/RL08i92h0ojgpFUrV0j4qrxBW+W5KJyl3YO/J4UJUD5e\n"
    "y3P5P4TxTWcSLtsxog46gBYxv+Lk3rWDHnwY9qz2ZHQ6gMbbo6mZWTXxOAPRsCrY\n"
    "atHUTyEJzpkEJVYezl0shyIzjvknQS9AGXQIPWztDDlv0t02Ol8+pCf13ppXd6Kp\n"
    "lB6rFb30ajKDDvPfKQA9Wx59Lvx3lWUOG4QC/IZwPDeUZniRBoRwiQTYrKmTPQFX\n"
    "2p+rabkohRzz+7wuxc+td3Kzxd+V4K9/yD2KfBu1ZRMG8GAFm8G83HS+YBR/vQEQ\n"
    "sf0ohJquCEeBdCbG2PC4b9JUNHSRfX6S3qXeONcND+BNyiTeMAbTf4uhpzFcv3Tq\n"
    "5Tbda3T1U6r4SDE17jdnrbivA9OKOiDwKnYXzk32K1jAw+mV2bp0B1MMO5kDnFus\n"
    "5GpEWQdmGHC2WAYLju5raUNbcuiAKZJoNT3Mzndo6pjsMIDo1+Mo6wAfPCoU/wPk\n"
    "utxOfZP0oxv6/aCukaH1zGFy6fW0W3P79gwXQAVvbAd5pUTFXzmZj9xQM98T+eH5\n"
    "3E4yPrs7qg1SWbyQepHfBtAGu7tlaoW+nZ6WlT9yoeflVdGXt4kGBcrIYxnVLu3J\n"
    "bUqe9AXArIDY9tPI3AS/LamsGCK06UftA7eXgccjvJ2rK1A3JKbzq/zkpSAcmVic\n"
    "BCPU+yr6J6nSYmNNbTWV0mkTqYPBI5z9Cfl0DH0oeViHyuCsI+9mIQGni+Zd2209\n"
    "QtGELSlhq5FKtexb3iQOPNRIcfmE64JG3SOdIyv8NI8EyYPg1KeItdpPAkPQQI79\n"
    "08VUhE+kS9Z8WGiJzOgZsxLRMWXy9dislgY8gUYme+TTxaskxv0mlxjsBuzJRLxR\n"
    "K1aPIzwi37gsxSo/i35IjkrdJGoUPk0/c2Q3L7Eh//ioMFDFYepIvnT58BlAfDIc\n"
    "u2cHWi8O2/hjlw7MvZO79siaFFvHBOOhGxTqENpcG5UqgRP6Td+nH/vofs8/aUPg\n"
    "ghL9oxpnQ9t5Hj60XoHZgVYyeseEsQqzF/pWk4FgsQFdjtXdwiwBbFDQViWiIe/Q\n"
    "w+sklgfuQdkVsl9z3rKzLUpWfbopBTjjh0feFk8FdDZ8VkH8nnT0iT+IEIaGK3dN\n"
    "05szbETbMvY6/ZsadK8XPboGO5elgyquMFe6Khwn7puguCXOT4f+0JEtp4DZRay+\n"
    "anizvHNIsQVrIF7yE6RUVWiFM0Jcv3gZDKGYV2ZCqyI0Jy5zJ5CQGlCdxF5HQ/kU\n"
    "w+6DKN6ITUT8v1sU/4GAuh+LVwTdUsNjUQ6I3aD4KKBexXYv39PxORz2xn1uzs4U\n"
    "0xFTbk7VYLGB+sS0ejj0xiuskwWgkVNzsrz5k8ysADRgc4Oh6B0oN15jaWxzjJWi\n"
    "st7i/v8NGmdqb4CpwsXQ0env8f5ZW2VobX+BhZilq7O6wM7e/wAAAAAAAAAAAAAA\n"
    "AAAAAAAAAAAAAAAAAAAHFyY3\n"
    "-----END CERTIFICATE-----\n"
;

/* ECDSA P-256 CA */
static const char ca_cert_ecc_pem[] =
    "-----BEGIN CERTIFICATE-----\n"
    "MIIClTCCAjugAwIBAgIUMLkwUPgaDf+taNFt6KNrWCMzeoQwCgYIKoZIzj0EAwIw\n"
    "gZcxCzAJBgNVBAYTAlVTMRMwEQYDVQQIDApXYXNoaW5ndG9uMRAwDgYDVQQHDAdT\n"
    "ZWF0dGxlMRAwDgYDVQQKDAd3b2xmU1NMMRQwEgYDVQQLDAtEZXZlbG9wbWVudDEY\n"
    "MBYGA1UEAwwPd3d3LndvbGZzc2wuY29tMR8wHQYJKoZIhvcNAQkBFhBpbmZvQHdv\n"
    "bGZzc2wuY29tMB4XDTI0MTIxODIxMjUyOVoXDTI3MDkxNDIxMjUyOVowgZcxCzAJ\n"
    "BgNVBAYTAlVTMRMwEQYDVQQIDApXYXNoaW5ndG9uMRAwDgYDVQQHDAdTZWF0dGxl\n"
    "MRAwDgYDVQQKDAd3b2xmU1NMMRQwEgYDVQQLDAtEZXZlbG9wbWVudDEYMBYGA1UE\n"
    "AwwPd3d3LndvbGZzc2wuY29tMR8wHQYJKoZIhvcNAQkBFhBpbmZvQHdvbGZzc2wu\n"
    "Y29tMFkwEwYHKoZIzj0CAQYIKoZIzj0DAQcDQgAEAtPZbtYBjkXIuZAx5cBM456t\n"
    "KTiYuhDW6QkqgKkuFyq5ir8zg0bjlQvkd0C1O0NFMw9hU3w3RMHL/IDK6EPqp6Nj\n"
    "MGEwHQYDVR0OBBYEFFaOmsPwQt4YuUVVbvmTz+rD86UhMB8GA1UdIwQYMBaAFFaO\n"
    "msPwQt4YuUVVbvmTz+rD86UhMA8GA1UdEwEB/wQFMAMBAf8wDgYDVR0PAQH/BAQD\n"
    "AgGGMAoGCCqGSM49BAMCA0gAMEUCIQCIzH8A9alOwGluNjkkj4NFTfrQORS4yH+V\n"
    "UfLFmMC34gIgKpNhsAbe69r9r2s5v4gX8boqfVmo3ucKEYNPkneNkjs=\n"
    "-----END CERTIFICATE-----\n"
;

#endif /* CA_CERTS_H */
```

## include/config-mbedtls-wifi.h
```c
/*
 * config-mbedtls-wifi.h
 * Minimal mbedTLS configuration for ESP32 WiFi driver (WPA2-Personal) ONLY.
 *
 * The application TLS/DTLS backend uses wolfSSL, NOT mbedTLS.
 * This config provides only the raw crypto primitives that the ESP-IDF
 * wpa_supplicant needs: AES, CCM, CMAC, SHA-256, HMAC, DES, bignum, NIST-KW.
 *
 * Copyright (C) 2006-2015, ARM Limited, All Rights Reserved
 * Copyright (c) 2017 Intel Corporation.
 * Copyright (c) 2018 Nordic Semiconductor ASA
 * Copyright (C) 2024-2025 Javier Blanco-Romero @fj-blanco (UC3M, QURSA project)
 *
 * SPDX-License-Identifier: Apache-2.0
 */

#ifndef CONFIG_MBEDTLS_WIFI_H
#define CONFIG_MBEDTLS_WIFI_H

/* ---- Crypto primitives used by wpa_supplicant ---- */

/* AES (ECB/CBC/CTR) — always needed for WPA2 CCMP */
#ifndef MBEDTLS_AES_C
#define MBEDTLS_AES_C
#endif

/* CCM mode — used by WPA2 CCMP */
#if defined(MBEDTLS_CCM_C)
#ifndef MBEDTLS_CCM_GCM_CAN_AES
#define MBEDTLS_CCM_GCM_CAN_AES
#endif
#endif

/* SHA-256 — needed for HMAC / key derivation in 4-way handshake */
#ifndef MBEDTLS_MD_CAN_SHA256
#define MBEDTLS_MD_CAN_SHA256
#endif

#endif /* CONFIG_MBEDTLS_WIFI_H */
```

## include/config-wolfssl-libcoap.h
```c
/*
 * config-wolfssl-libcoap.h
 * wolfSSL configuration for libcoap ESP32 client — memory-optimised
 *
 * Supports key-exchange algorithms selected at compile time via
 * COAP_WOLFSSL_GROUPS and signature algorithms via COAP_WOLFSSL_SIG.
 *
 * Key exchange (COAP_WOLFSSL_GROUPS → WOLFSSL_ALGO_*):
 *   "P-256"        → WOLFSSL_ALGO_ECDHE_P256  (default)
 *   "X25519"       → WOLFSSL_ALGO_X25519
 *   "ML_KEM_512"   → WOLFSSL_ALGO_MLKEM512
 *
 * Signature / certificate authentication (COAP_WOLFSSL_SIG → WOLFSSL_SIG_*):
 *   "ECDSA_P256"   → WOLFSSL_SIG_ECDSA_P256  (default)
 *   "ML_DSA_44"    → WOLFSSL_SIG_MLDSA44
 *
 * ML-KEM-768 and ML-KEM-1024 are supported at the build level but crash
 * at runtime on ESP32 due to heap exhaustion during DTLS handshake message
 * reassembly (DtlsMsgCombineFragBuckets → z_realloc exceeds available DRAM).
 *
 * Aggressively tuned for ESP32 DRAM limits (~192 KB total).
 * Every define here was audited for its impact on heap-allocated
 * struct sizes (WOLFSSL, WOLFSSL_CTX) and on per-connection buffers.
 *
 * Copyright (C) 2024-2025 Javier Blanco-Romero @fj-blanco (UC3M, QURSA project)
 */

#ifndef WOLFSSL_SETTINGS_H
#define WOLFSSL_SETTINGS_H

#ifdef __cplusplus
extern "C" {
#endif

#ifndef WOLFSSL_USER_SETTINGS
#define WOLFSSL_USER_SETTINGS
#endif

/* ==================== Algorithm Selection ==================== */

/* --- Key exchange: exactly ONE must be defined --- */
#if !defined(WOLFSSL_ALGO_ECDHE_P256) && !defined(WOLFSSL_ALGO_X25519) && \
    !defined(WOLFSSL_ALGO_MLKEM512)   && !defined(WOLFSSL_ALGO_MLKEM768) && \
    !defined(WOLFSSL_ALGO_MLKEM1024)
#define WOLFSSL_ALGO_ECDHE_P256
#endif

/* --- Signature / certificate authentication --- */
/* Default: ECDSA P-256.  Set WOLFSSL_SIG_MLDSA44 for post-quantum sigs. */
#if !defined(WOLFSSL_SIG_ECDSA_P256) && !defined(WOLFSSL_SIG_MLDSA44)
#define WOLFSSL_SIG_ECDSA_P256
#endif

/* Helper: any ML-KEM variant selected? */
#if defined(WOLFSSL_ALGO_MLKEM512) || defined(WOLFSSL_ALGO_MLKEM768) || \
    defined(WOLFSSL_ALGO_MLKEM1024)
#define _WOLFSSL_ALGO_MLKEM_ANY
#endif

/* Helper: do we need SHA-3 / SHAKE for any PQC algorithm? */
#if defined(_WOLFSSL_ALGO_MLKEM_ANY) || defined(WOLFSSL_SIG_MLDSA44)
#define _WOLFSSL_NEED_SHA3_SHAKE
#endif

/* ==================== Platform ==================== */

#ifndef WOLFSSL_ZEPHYR
#define WOLFSSL_ZEPHYR
#endif

#define NO_STDIO_FILESYSTEM
#define NO_WRITEV
#define NO_DEV_RANDOM
#define HAVE_CUSTOM_RNG
#define NO_MAIN_DRIVER
#define NO_BIO
#define WOLFSSL_NO_STDIO
#define NO_PWDBASED
#define NO_ERROR_QUEUE
#define WOLFSSL_NO_STDIO_PRINTF

/* ==================== TLS / DTLS ==================== */

#define WOLFSSL_DTLS
#define HAVE_SOCKADDR

/* TLS 1.3 — required by DTLS 1.3 (wolfSSL enforces this with #error) */
#define WOLFSSL_TLS13

/* DTLS 1.3 — post-quantum CoAP over DTLS */
#define WOLFSSL_DTLS13

/* WOLFSSL_DTLS_CH_FRAG intentionally NOT defined.
 * The first ClientHello is always small because coap_wolfssl.c calls
 * wolfSSL_NoKeyShares() (gated by WOLFSSL_SEND_HRR_COOKIE), so the
 * ML-KEM key share is never sent in CH1. The server replies with
 * HelloRetryRequest + cookie, and the second ClientHello (with the
 * full ML-KEM key share) uses standard DTLS handshake message
 * fragmentation. This avoids modifying upstream wolfSSL source
 * (dtls13.c CH_FRAG block contains server-only code that fails to
 * compile with NO_WOLFSSL_SERVER).
 * The wolfSSL build will emit a -Wcpp warning about missing CH_FRAG
 * for PQC + DTLS 1.3 — this is benign and expected. */

/* DTLS 1.3 HRR cookie exchange: although WOLFSSL_SEND_HRR_COOKIE sounds
 * server-only, wolfSSL gates ALL cookie extension handling (parse / write /
 * free / get-size) behind this define.  Without it the CLIENT cannot parse
 * the cookie from the server's HelloRetryRequest, so its second
 * ClientHello is identical to the first and the server rejects it with
 * DUPLICATE_MSG_E.  Enabling it also lets coap_wolfssl.c call
 * wolfSSL_NoKeyShares(), the standard DTLS 1.3 cookie flow.
 * Server-only code (CreateCookieExt, DoClientHelloStateless, …) is
 * separately gated by !NO_WOLFSSL_SERVER, so this is safe for the
 * client-only build.
 */
#define WOLFSSL_SEND_HRR_COOKIE

/* --- REMOVED (saves heap per-connection): ---
 * WOLFSSL_DTLS_CID — adds Connection-ID fields to every WOLFSSL struct.
 */

#undef NO_TLS
#undef NO_WOLFSSL_CLIENT

/* Client only — removes server state machine, handshake buffers, etc. */
#define NO_WOLFSSL_SERVER

/* TLS extensions needed by libcoap */
#define HAVE_TLS_EXTENSIONS
#define HAVE_SUPPORTED_CURVES
#define HAVE_SNI   /* wolfSSL_set_tlsext_host_name() used by coap_wolfssl.c */

/* --- REMOVED (not needed, saves struct fields + code): ---
 * HAVE_EXTENDED_MASTER — TLS ≤1.2 feature; DTLS 1.3 doesn't use it.
 */

/* ==================== Key Exchange: X25519 ==================== */

#ifdef WOLFSSL_ALGO_X25519
#define HAVE_CURVE25519
#define CURVE25519_SMALL          /* save DRAM on ESP32 */
#endif

/* ==================== Key Exchange: ML-KEM (FIPS 203) ==================== */

#ifdef _WOLFSSL_ALGO_MLKEM_ANY
/* wolfSSL 5.8.2+ native ML-KEM (no liboqs) */
#define WOLFSSL_HAVE_MLKEM
#define WOLFSSL_WC_MLKEM
/* ── Per-level disable workaround ──
 * Ideally we would define WOLFSSL_NO_ML_KEM_<level> for unneeded levels
 * to save flash/DRAM.  However, wolfSSL 5.8.2 has a bug in
 * TLSX_IsGroupSupported() (tls.c ~line 4580): the switch-case for all
 * three ML-KEM levels shares a single `break;` that lives inside
 * `#ifndef WOLFSSL_NO_ML_KEM_1024`.  When ML-KEM-1024 is compiled out,
 * the ML-KEM-512 / ML-KEM-768 cases fall through without a `break;` and
 * the function returns 0 (not supported).  This causes
 * wolfSSL_CTX_set1_groups_list("ML_KEM_512") to silently fail, the
 * ClientHello omits the group from supported_groups, and the server
 * replies with Alert 109 (missing_extension).
 *
 * Workaround: enable all three levels at compile time.  Only the group
 * passed via COAP_WOLFSSL_GROUPS is actually negotiated at runtime, so
 * the extra code from unused levels costs ~20-30 KB flash but negligible
 * extra DRAM (key material is heap-allocated on demand).
 */
/* ML-KEM small-memory optimisations (from wolfSSL blog Aug 2025).
 * Reduces ML-KEM heap usage by 10-15% by using smaller working buffers
 * for key generation and encapsulation.  No impact on non-PQC builds. */
#define WOLFSSL_MLKEM_ENCAPSULATE_SMALL_MEM
#define WOLFSSL_MLKEM_MAKEKEY_SMALL_MEM
#endif /* _WOLFSSL_ALGO_MLKEM_ANY */

/* ==================== Signature: ML-DSA-44 (FIPS 204) ==================== */

#ifdef WOLFSSL_SIG_MLDSA44
/* wolfSSL 5.8.2+ native ML-DSA (Dilithium) — no liboqs needed */
#define HAVE_DILITHIUM
#define WOLFSSL_WC_DILITHIUM
/* Only compile ML-DSA-44 (Level 2); exclude larger parameter sets */
#define WOLFSSL_NO_ML_DSA_65
#define WOLFSSL_NO_ML_DSA_87
/* Client only verifies server certificates — disable keygen and signing
 * to save substantial code and DRAM */
#define WOLFSSL_DILITHIUM_VERIFY_ONLY
/* Low-memory verification — processes matrix A one row at a time. */
#define WOLFSSL_DILITHIUM_VERIFY_SMALL_MEM
/* Smaller code size (slower, but ESP32 is not time-critical for verify) */
#define WOLFSSL_DILITHIUM_SMALL
/* NOTE: WOLFSSL_DILITHIUM_ASSIGN_KEY cannot be used — the cert DER buffer is
 * freed between cert chain verification and CertificateVerify processing,
 * making the pointer-only public key a stale reference (commit_cmp fails).
 * The full 1312-byte public key copy is required for correct verification. */
#endif /* WOLFSSL_SIG_MLDSA44 */

/* ==================== SHA-3 / SHAKE (shared by ML-KEM and ML-DSA) ==================== */

#ifdef _WOLFSSL_NEED_SHA3_SHAKE
#define WOLFSSL_SHA3
#define WOLFSSL_SHAKE128
#define WOLFSSL_SHAKE256
#endif

/* ==================== Session ==================== */

/* No session resumption needed — each benchmark run creates a fresh session */
#define NO_SESSION_CACHE
#define NO_SESSION_CACHE_REF

/* ==================== Certificates & X.509 (minimal) ==================== */

#undef NO_CERTS
#define WOLFSSL_ASN_TEMPLATE
#define WOLFSSL_DER_LOAD
#define WOLFSSL_PEM_TO_DER
#define WOLFSSL_CERT_VERIFY

/* NO_KEEP_PEER_CERT: prevent OPENSSL_EXTRA from auto-defining KEEP_PEER_CERT
 * in settings.h.  With KEEP_PEER_CERT, ProcessPeerCerts calls
 * CopyDecodedToX509() to populate the embedded ssl->peerCert field.  On
 * ESP32 with ML-DSA-44, this allocation fails (MEMORY_E) at peak heap
 * usage and triggers a fatal handshake abort — requiring a wolfSSL source
 * patch.
 *
 * Without KEEP_PEER_CERT:
 *   - The embedded peerCert field is removed from WOLFSSL, saving ~2 KB
 *     of heap per connection.
 *   - CopyDecodedToX509 is skipped in ProcessPeerCerts entirely.
 *   - If certificate validation succeeds (cert_err == 0), DoVerifyCallback
 *     never calls SetupStoreCtxCallback, so no X509 allocation at all.
 *   - ConfirmSignature (the actual ML-DSA-44 crypto verification) still
 *     runs regardless.
 *
 * This avoids any source-level modification to wolfSSL. */
#define NO_KEEP_PEER_CERT

/* Callback support for libcoap */
#define HAVE_EX_DATA

/* OpenSSL compatibility — required by libcoap's wolfSSL backend.
 * OPENSSL_EXTRA alone covers all 21 functions libcoap needs EXCEPT
 * wolfSSL_CIPHER_get_cipher_nid() and wolfSSL_CIPHER_get_digest_nid()
 * (used in coap_dtls_get_overhead()).  We patch that function to use a
 * fixed overhead for DTLS 1.3 AES-128-GCM instead of importing
 * OPENSSL_ALL which bloats the WOLFSSL struct. */
#define OPENSSL_EXTRA

/* ==================== Crypto algorithms ==================== */

/* Hash — only SHA-256 needed for TLS_AES_128_GCM_SHA256 */
#define WOLFSSL_SHA256
#define HAVE_HKDF
#undef NO_HMAC
/* --- REMOVED: SHA384, SHA512 --- not needed for the single TLS 1.3
 * cipher suite we use.  Saves ~4 KB code and hash-state heap. */

/* ECC — always on for compatibility with wolfSSL's cipher suite requirements.
 * Used for ECDSA certificate authentication and/or ECDHE P-256 key exchange.
 * Even with ML-DSA-44 signatures, ECC is needed by wolfSSL's internal guards. */
#define HAVE_ECC
#define ECC_TIMING_RESISTANT
#define HAVE_ECC_VERIFY
#define HAVE_ECC_SIGN

/* AES — only AES-128-GCM needed for TLS_AES_128_GCM_SHA256 */
#define HAVE_AES
#define HAVE_AESGCM
#define WOLFSSL_AES_128
/* --- REMOVED: AES-256 --- not needed; saves ~2 KB key-schedule tables. */

/* GCM_SMALL — use smaller GCM multiplication table (saves ~3-4 KB DRAM,
 * trades a bit of AES-GCM performance for reduced memory) */
#define GCM_SMALL

/* Smaller AES S-box tables — saves DRAM (256 bytes vs 4 KB) */
#define WOLFSSL_AES_SMALL_TABLES

/* Disable RSA — not used for certificates or key exchange */
#define NO_RSA

/* Disable DH — ML-KEM / ECDHE provide key exchange */
#define NO_DH

/* Random number generation */
#define HAVE_HASHDRBG
#define WC_RNG_SEED_CB

/* ==================== Memory & stack optimisation ==================== */

/* ESP32 has no battery-backed RTC — boots at epoch (1970-01-01).  Skip all
 * ASN.1 date validation so that ParseCertRelative does not return
 * ASN_BEFORE_DATE_E, which would otherwise trigger a fatal alert before
 * the verify callback has a chance to override it. */
#define NO_ASN_TIME

#define WOLFSSL_SMALL_STACK
/* --- REMOVED: WOLFSSL_SMALL_STACK_CACHE --- caches crypto working buffers
 * on the heap, increasing per-connection heap usage.  Without it, wolfSSL
 * allocates from the stack per-operation (covered by WOLFSSL_SMALL_STACK). */

/* ---- I/O buffer size reduction for CoAP over WiFi (MTU ~1500) ----
 * Without these, wolfSSL_connect() dynamically grows the output buffer
 * to OUTPUT_RECORD_SIZE = MAX_RECORD_SIZE = 16384 during handshake,
 * which is the main cause of MEMORY_E (-125) on ESP32.
 *
 * STATIC_CHUNKS_ONLY: caps output buffer to RECORD_SIZE (1400 for DTLS)
 *   instead of 16384.  Handshake messages get fragmented to MTU, which
 *   is exactly what DTLS is designed to do.
 * WOLFSSL_DTLS_MTU: enables MTU-aware I/O sizing and wolfSSL_dtls_set_mtu().
 * WOLFSSL_MAX_MTU: ceiling for DTLS packet size (1400 = 1500 - IP/UDP).
 * WOLFSSL_DTLS_MTU_ADDITIONAL_READ_BUFFER: extra read headroom (default 500,
 *   reduced to 100 since we control the server).
 */
#define STATIC_CHUNKS_ONLY
#define WOLFSSL_DTLS_MTU
#define WOLFSSL_MAX_MTU              1400
#define WOLFSSL_DTLS_MTU_ADDITIONAL_READ_BUFFER  100

#define NO_BENCH
#define WOLFSSL_NO_BENCH

/* Disabled heavyweight features */
#define NO_DSA
#define NO_RC4
#define NO_MD4
#define NO_MD5
#define NO_OLD_TLS

/* Error strings off to save ~10 KB flash + rodata.
 * Diagnostic stage globals in coap_wolfssl.c provide error visibility. */
#define NO_ERROR_STRINGS

/* Math library — SP small for ECC only (no RSA/DH SP needed) */
#define WOLFSSL_SP_MATH_ALL
#define WOLFSSL_SP_SMALL
#define WOLFSSL_HAVE_SP_ECC

/* Threading */
#define SINGLE_THREADED

/* ==================== Memory allocator override ==================== */
/* On Zephyr with newlib, malloc() uses newlib's tiny sbrk-based heap
 * (only ~22 KB from leftover DRAM), while k_malloc() uses the Zephyr
 * system heap sized by CONFIG_HEAP_MEM_POOL_SIZE (80 KB).
 * wolfSSL defaults to malloc() → newlib heap → OOM during handshake.
 *
 * XMALLOC_OVERRIDE tells wolfSSL to skip its default malloc definitions
 * and use our macros instead.  These redirect all wolfSSL allocations
 * to k_malloc/k_free, giving wolfSSL access to the full system heap.
 *
 * Note: k_malloc/k_free are declared in <zephyr/kernel.h> which is
 * included by wolfssl/wolfcrypt/settings.h (WOLFSSL_ZEPHYR block)
 * AFTER this user_settings header.  Macros are text-substituted at
 * point of use, so the declarations are available when XMALLOC expands.
 *
 * CRITICAL: We must NOT use wolfSSL's default z_realloc() for XREALLOC.
 * z_realloc() (wolfcrypt/src/memory.c) calls newlib's realloc(), but
 * XMALLOC/XFREE use Zephyr's k_malloc/k_free.  Passing a k_malloc
 * pointer to newlib's realloc() is an allocator mismatch that crashes
 * in _free_r during DtlsMsgCombineFragBuckets (DTLS fragment
 * reassembly for large ML-DSA-44 certificates).
 * XREALLOC uses Zephyr's k_realloc() which operates on the same
 * system heap as k_malloc/k_free, avoiding the mismatch.
 */
#define XMALLOC_OVERRIDE
#define XMALLOC(s, h, t)     ((void)(h), (void)(t), k_malloc((size_t)(s)))
#define XFREE(p, h, t)       do { void* xp = (p); (void)(h); (void)(t); \
                                if (xp) k_free(xp); } while (0)
#define XREALLOC(p, n, h, t) ((void)(h), (void)(t), k_realloc((p), (size_t)(n)))

/* ==================== Debug ==================== */

#ifdef CONFIG_WOLFSSL_DEBUG
    #ifndef DEBUG_WOLFSSL
        #define DEBUG_WOLFSSL
    #endif
    /* Re-enable error strings when debug is on */
    #undef NO_ERROR_STRINGS
#endif

#ifdef __cplusplus
}
#endif

#endif /* WOLFSSL_SETTINGS_H */
```

## include/wifi.h
```c
/*
* mbedtls/include/wifi.h
*
* Copyright (C) 2024-2025 Javier Blanco-Romero @fj-blanco (UC3M, QURSA project)
* Author: Javier Blanco-Romero
*
* Wi-Fi management header for CoAP client
*/

#include <zephyr/kernel.h>
#include <zephyr/net/net_if.h>
#include <zephyr/net/wifi_mgmt.h>

extern struct wifi_connect_req_params wifi_params;
void wifi_mgmt_event_handler(struct net_mgmt_event_callback *cb,
                             uint32_t mgmt_event, struct net_if *iface);
int wifi_init(struct device *unused);
int shell_cmd_scan(void);
int wait_for_wifi_connection(void);
int connect_to_wifi(void);
void wifi_disconnect(void);
bool wifi_is_connected(void);
int wifi_reconnect(void);
```

## src/wifi.c
```c
/*
 * mbedtls/src/wifi.c
 *
 * Copyright (C) 2024-2025 Javier Blanco-Romero @fj-blanco (UC3M, QURSA project)
 *
 * Wi-Fi management for CoAP client
 */

#include <stdio.h>
#include <zephyr/net/net_event.h>
#include <zephyr/net/net_if.h>
#include <zephyr/net/socket.h>
#include <zephyr/net/wifi_mgmt.h>
#include <zephyr/net/wifi_utils.h>
#include "wifi.h"

#ifndef WIFI_SSID
#define WIFI_SSID "WIFI_SSID_NOT_SET"
#endif

#ifndef WIFI_PASS
#define WIFI_PASS "WIFI_PASS_NOT_SET"  
#endif

#define WIFI_CONNECTION_TIMEOUT_MS 10000 // 10 seconds

struct wifi_connect_req_params wifi_params = {
    .ssid = WIFI_SSID,
    .ssid_length = sizeof(WIFI_SSID) - 1,
    .psk = WIFI_PASS,
    .psk_length = sizeof(WIFI_PASS) - 1,
    .channel = WIFI_CHANNEL_ANY,
    .security = WIFI_SECURITY_TYPE_PSK,
    .mfp = WIFI_MFP_OPTIONAL,
    .timeout = SYS_FOREVER_MS};

#define WIFI_SHELL_MGMT_EVENTS                                                 \
    (NET_EVENT_WIFI_SCAN_RESULT | NET_EVENT_WIFI_SCAN_DONE |                   \
     NET_EVENT_WIFI_CONNECT_RESULT | NET_EVENT_WIFI_DISCONNECT_RESULT)

static union {
    struct {
        uint8_t connecting : 1;
        uint8_t disconnecting : 1;
        uint8_t _unused : 6;
    };
    uint8_t all;
} context;

static uint32_t scan_result;
static bool wifi_connected = false;
static struct net_mgmt_event_callback wifi_event_cb;

static void handle_wifi_scan_result(struct net_mgmt_event_callback *cb) {
    const struct wifi_scan_result *entry =
        (const struct wifi_scan_result *)cb->info;

    scan_result++;

    if (scan_result == 1) {
        printf("\n%-4s | %-32s %-5s | %-4s | %-4s | %-5s\n", "Num", "SSID",
               "(len)", "Chan", "RSSI", "Sec");
    }

    printf("%-4d | %-32s %-5u | %-4u | %-4d | %-5s\n", scan_result, entry->ssid,
           entry->ssid_length, entry->channel, entry->rssi,
           (entry->security == WIFI_SECURITY_TYPE_PSK ? "WPA/WPA2" : "Open"));
}

static void handle_wifi_scan_done(struct net_mgmt_event_callback *cb) {
    const struct wifi_status *status = (const struct wifi_status *)cb->info;

    if (status->status) {
        printf("\nWi-Fi scan request failed (%d)\n", status->status);
    } else {
        printf("----------\n");
        printf("Wi-Fi scan request done\n");
    }

    scan_result = 0;
}

static void handle_wifi_connect_result(struct net_mgmt_event_callback *cb) {
    const struct wifi_status *status = (const struct wifi_status *)cb->info;

    if (status->status) {
        printf("\nWi-Fi connection request failed (%d)\n", status->status);
    } else {
        printf("\nWi-Fi connected\n");
        wifi_connected = true;
    }

    context.connecting = false;
}

static void handle_wifi_disconnect_result(struct net_mgmt_event_callback *cb) {
    const struct wifi_status *status = (const struct wifi_status *)cb->info;

    wifi_connected = false;

    if (context.disconnecting) {
        printf("\nWi-Fi disconnection request %s (%d)\n",
               status->status ? "failed" : "done", status->status);
        context.disconnecting = false;
    } else {
        printf("\nWi-Fi Disconnected\n");
    }
}

bool wifi_is_connected(void)
{
    return wifi_connected;
}

int wifi_reconnect(void)
{
    if (wifi_connected) {
        return 0;
    }

    printf("[WIFI] Reconnecting...\n");
    wifi_disconnect();
    k_sleep(K_MSEC(2000));

    for (int attempt = 1; attempt <= 5; attempt++) {
        wifi_connected = false;
        int ret = connect_to_wifi();
        if (ret >= 0 && wait_for_wifi_connection() >= 0) {
            printf("[WIFI] Reconnected (attempt %d)\n", attempt);
            k_sleep(K_MSEC(1000));
            return 0;
        }
        printf("[WIFI] Reconnect attempt %d/5 failed\n", attempt);
        wifi_disconnect();
        k_sleep(K_MSEC(3000));
    }

    printf("[WIFI] Reconnection failed after 5 attempts\n");
    return -1;
}

void wifi_mgmt_event_handler(struct net_mgmt_event_callback *cb,
                             uint32_t mgmt_event, struct net_if *iface) {
    switch (mgmt_event) {
    case NET_EVENT_WIFI_SCAN_RESULT:
        handle_wifi_scan_result(cb);
        break;
    case NET_EVENT_WIFI_SCAN_DONE:
        handle_wifi_scan_done(cb);
        break;
    case NET_EVENT_WIFI_CONNECT_RESULT:
        handle_wifi_connect_result(cb);
        break;
    case NET_EVENT_WIFI_DISCONNECT_RESULT:
        handle_wifi_disconnect_result(cb);
        break;
    default:
        break;
    }
}

int wifi_init(struct device *unused) {
    ARG_UNUSED(unused);

    context.all = 0;
    scan_result = 0;

    net_mgmt_init_event_callback(&wifi_event_cb, wifi_mgmt_event_handler,
                                 WIFI_SHELL_MGMT_EVENTS);

    printf("Wi-Fi event callback initialized......\n");
    net_mgmt_add_event_callback(&wifi_event_cb);

    return 0;
}

int shell_cmd_scan() {
    struct net_if *iface = net_if_get_default();

    if (net_mgmt(NET_REQUEST_WIFI_SCAN, iface, NULL, 0)) {
        printf("Wi-Fi scan request failed\n");
    } else {
        printf("Wi-Fi scan requested\n");
    }

    return 0;
}

int wait_for_wifi_connection(void) {
    int timeout_count = 0;
    int max_timeout_count = WIFI_CONNECTION_TIMEOUT_MS / 100;

    while (!wifi_connected) {
        k_sleep(K_MSEC(100)); // Sleep for 100 ms
        timeout_count++;

        if (timeout_count >= max_timeout_count) {
            printf("Wi-Fi connection timeout after %d ms\n",
                   WIFI_CONNECTION_TIMEOUT_MS);
            return -ETIMEDOUT;
        }
    }

    printf("Wi-Fi connected successfully\n");
    return 0;
}

void wifi_disconnect(void) {
    struct net_if *iface = net_if_get_default();

    if (net_mgmt(NET_REQUEST_WIFI_DISCONNECT, iface, NULL, 0)) {
        printf("Wi-Fi Disconnection Request Failed\n");
    } else {
        printf("Wi-Fi Disconnection Requested\n");
    }
}

int connect_to_wifi() {
    printf("Connecting to Wi-Fi network......\n");
    int ret;

    struct net_if *iface = net_if_get_default();

    if (!iface) {
        printf("Failed to get Wi-Fi device\n");
        return -ENODEV;
    }
    ret = net_mgmt(NET_REQUEST_WIFI_CONNECT, iface, &wifi_params,
                   sizeof(struct wifi_connect_req_params));

    if (ret < 0) {
        printf("Failed to connect to Wi-Fi network: %d\n", ret);
        return ret;
    }

    printf("Wi-Fi connection requested\n");
    return ret;
}
```
